## sdkconfig.defaults
```kconfig
# sdkconfig.defaults
#
# Settings shared across all OneCollar hardware revisions. Per-rev overrides
# live in sdkconfig.defaults.${BOARD}.

# --- Target ---
CONFIG_IDF_TARGET="esp32s3"

# --- Flash ---
CONFIG_ESPTOOLPY_FLASHSIZE_16MB=y
CONFIG_ESPTOOLPY_FLASHSIZE="16MB"

# --- Partition table ---
CONFIG_PARTITION_TABLE_CUSTOM=y
CONFIG_PARTITION_TABLE_CUSTOM_FILENAME="partitions.csv"
CONFIG_PARTITION_TABLE_FILENAME="partitions.csv"

# --- PSRAM ---
# Module is N16R8 (8 MB octal PSRAM), but board.h flags it as DO NOT USE
# until application demand justifies the GPIO cost. Disabled for now.
CONFIG_SPIRAM=n

# --- Logging ---
CONFIG_LOG_DEFAULT_LEVEL_INFO=y
CONFIG_LOG_DEFAULT_LEVEL=3

# --- USB CDC for native console (S3 USB pins on GPIO19/20) ---
CONFIG_ESP_CONSOLE_USB_SERIAL_JTAG=y

# --- FreeRTOS ---
CONFIG_FREERTOS_HZ=1000

# --- BLE / NimBLE host (preferred over Bluedroid for footprint) ---
CONFIG_BT_ENABLED=y
CONFIG_BT_NIMBLE_ENABLED=y
# Preferred ATT MTU = 512 per contracts/ble_protocol.md §Locked decisions.
# The peer may still negotiate down; this is the upper bound the collar requests.
CONFIG_BT_NIMBLE_ATT_PREFERRED_MTU=512
# LESC bonding state persisted in NVS so gate 4 of the mobile-library eval
# (bonding survives app restart) can be exercised.
CONFIG_BT_NIMBLE_NVS_PERSIST=y

# --- Watchdog ---
CONFIG_ESP_TASK_WDT_INIT=y
CONFIG_ESP_TASK_WDT_TIMEOUT_S=10
```

## sdkconfig.defaults.rev7
```kconfig
# sdkconfig.defaults.rev7
#
# Rev 7 specific overrides.

# --- I2S MEMS microphone (Tier 2 audio) ---
CONFIG_I2S_ENABLE_DEBUG_LOG=n
```
